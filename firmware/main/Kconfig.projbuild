## firmware/main/Kconfig.projbuild
```kconfig
menu "MakerLabs ACM Configuration"

#config SPREADSHEET_ID
#  string "Google Apps Spreadsheet ID"
#  default ""
#  help
#    Google Apps Spreadsheet ID
#
#config SPREADSHEET_USERS_SHEET_GID
#  string "Google Apps 'Users' Sheet ID (GID)"
#  default ""
#  help
#    Google Apps 'Users' Sheet ID (GID)
#
#config SPREADSHEET_USERS_SHEET_NAME
#  string "Google Apps 'Users' Sheet Name"
#  default "Users"
#  help
#    Google Apps 'Users' Sheet Name
#
#config SPREADSHEET_ACTIVITY_SHEET_NAME
#  string "Google Apps 'Activity' Sheet Name"
#  default "Activity"
#  help
#    Google Apps 'Activity' Sheet Name
#
#config SPREADSHEET_LOGS_SHEET_NAME
#  string "Google Apps 'Logs' Sheet Name"
#  default "Logs"
#  help
#    Google Apps 'Logs' Sheet Name

config ACM_OAUTH_CLIENT_ID
  string "OAuth Client ID"
  default ""
  help
    OAuth Client ID from created Webapp

config ACM_OAUTH_CLIENT_SECRET
  string "OAuth Client Secret"
  default ""
  help
    OAuth Client Secret from created Webapp

config ACM_OAUTH_REFRESH_TOKEN
  string "OAuth Refresh Token"
  default ""
  help
    OAuth refresh_token used to obtain fresh access_token's every hour

config ACM_ENABLE_SIGNED_IN_ACTIVITY
  prompt "Send Sign_In events to spreadsheet"
  bool
  default y
  help
    Send Sign_In events to Activity sheet when an RFID tag is first detected.
    Display User details from spreadsheet if found.

config ACM_ENABLE_SIGNED_OUT_ACTIVITY
  prompt "Send Sign_Out events to spreadsheet"
  bool
  default y
  help
    Send Sign_Out events to Activity sheet when an RFID tag is no longer detected.
    Clear the current User details if present.

config ACM_ENABLE_CNC_JOB_ACTIVITY
  prompt "Send CNC_Job events to spreadsheet"
  bool
  default y
  help
    Send CNC_Job events to Activity sheet after some activity has been detected.
    Sends one event at the beginning of the activity, and one event at the end
    which includes a time interval of how long the activity has lasted.

config ACM_ENABLE_PERMISSIONS_REQUIRED
  prompt "Require a User to have permission to access connected equipment"
  bool
  default y
  help
    Require a User to have a checkbox in a specific column in the spreadsheet,
    in order to enable the connected equipment.

config ACM_PERMISSION_COLUMN_LABEL
  string "Permission Column Label"
  default "Front Desk"
  help
    Label from column header row in Google Apps Spreadsheet

endmenu
```

## firmware/sdkconfig.defaults
```kconfig
CONFIG_ESPTOOLPY_PORT="/dev/tty.SLAB_USBtoUART"

# TTGO ESP32 Wifi + OLED dev board settings
CONFIG_ESPTOOLPY_BAUD_921600B=y
CONFIG_ESPTOOLPY_BAUD=921600
CONFIG_FLASHMODE_QIO=y
CONFIG_ESPTOOLPY_FLASHSIZE_16MB=y
CONFIG_ESPTOOLPY_FLASHSIZE="16MB"
CONFIG_MONITOR_BAUD_OTHER=y
CONFIG_MONITOR_BAUD_OTHER_VAL=460800
CONFIG_MONITOR_BAUD=460800
CONFIG_CONSOLE_UART_BAUDRATE=460800

# Run at 240 MHz (fastest)
CONFIG_ESP32_DEFAULT_CPU_FREQ_240=y
CONFIG_ESP32_DEFAULT_CPU_FREQ_MHZ=240

# FreeRTOS settings (tick @ 1ms)
CONFIG_FREERTOS_HZ=1000

# Use larger stack size for timer task so it can process actor messages
CONFIG_TIMER_TASK_STACK_DEPTH=16384

# Security / TLS hardware accel settings (use S/W)
CONFIG_MBEDTLS_HARDWARE_MPI=y
CONFIG_MBEDTLS_MPI_USE_INTERRUPT=y
CONFIG_MBEDTLS_HAVE_TIME_DATE=y

# Disable unused TLS features
CONFIG_MBEDTLS_TLS_CLIENT_ONLY=y
CONFIG_MBEDTLS_PEM_WRITE_C=
CONFIG_MBEDTLS_X509_CSR_PARSE_C=

# Partition table settings (factory + dual OTA)
CONFIG_PARTITION_TABLE_CUSTOM=y
CONFIG_PARTITION_TABLE_FILENAME="partitions.csv"

# Enable C++ Exceptions
CONFIG_CXX_EXCEPTIONS=y
CONFIG_CXX_EXCEPTIONS_EMG_POOL_SIZE=0

# Enable compiler warnings on misuse of strings / char arrays
CONFIG_WARN_WRITE_STRINGS=y

# Enable (strong) stack checking
CONFIG_STACK_CHECK=y
CONFIG_STACK_CHECK_STRONG=y
CONFIG_FREERTOS_WATCHPOINT_END_OF_STACK=y

# Enable heap checking
CONFIG_HEAP_POISONING_LIGHT=y

# Use (non-standard) 26 MHz clock
CONFIG_ESP32_XTAL_FREQ_26=y
CONFIG_ESP32_XTAL_FREQ=26

# Set custom cpu/task watchdog timeout in seconds
CONFIG_TASK_WDT_TIMEOUT_S=30

# Trigger panic after watchdog timeout
CONFIG_TASK_WDT_PANIC=y

# Use hardware accelerated SHA/MD5
CONFIG_MBEDTLS_HARDWARE_SHA=y

# Allow for an entire UUID string + null byte in task name strings
CONFIG_FREERTOS_MAX_TASK_NAME_LEN=37

# Wear levelling configuration (512 bytes sector size, verified writes)
CONFIG_WL_SECTOR_SIZE_512=y
CONFIG_WL_SECTOR_MODE_SAFE=y

# FATFS configuration
CONFIG_FATFS_LFN_HEAP=y
CONFIG_FATFS_API_ENCODING_UTF_8=y

# FATFS Partition Image Configuration
CONFIG_FATFS_PARTITION_BASE_ADDR=0x604000
CONFIG_FATFS_PARTITION_SIZE=131072
```
